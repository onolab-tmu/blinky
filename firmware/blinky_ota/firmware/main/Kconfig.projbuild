## firmware/blinky_ota/firmware/main/Kconfig.projbuild
```kconfig
menu "Blinky Configuration"

config WIFI_SSID
    string "WiFi SSID"
	default "myssid"
	help
		SSID (network name) for the example to connect to.

config WIFI_PASSWORD
    string "WiFi Password"
	default "mypassword"
	help
		WiFi password (WPA or WPA2) for the example to use.

		Can be left blank if the network has no security set.

config SERVER_IP
    string "HTTP Server IP"
	default "192.168.0.3"
	help
		HTTP Server IP to download the image file from.

config SERVER_PORT
	string "HTTP Server Port"
	default "8070"
	help
		HTTP Server port to connect to.
		Should be chosen not to conflict with any other port used
		on the system.

config BLINKY_NUMBER
    string "Individual number of blinky"
	default "1"

endmenu
```
